#include "splitty.dtsi"

&kscan0 {
  col-gpios =
    <&gpio0 28 GPIO_ACTIVE_HIGH>,
    <&gpio0 29 GPIO_ACTIVE_HIGH>,
    <&gpio0 2 GPIO_ACTIVE_HIGH>,
    <&gpio1 15 GPIO_ACTIVE_HIGH>,
    <&gpio1 13 GPIO_ACTIVE_HIGH>,
    <&gpio0 3 GPIO_ACTIVE_HIGH>;
};