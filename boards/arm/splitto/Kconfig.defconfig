## boards/arm/splitto/Kconfig.defconfig
```kconfig
if BOARD_SPLITTO_LEFT

# Name must be less than 16 characters long!
config ZMK_KEYBOARD_NAME
    default "Splitto kb"

config ZMK_SPLIT_ROLE_CENTRAL
    default y

endif # LEFT

if BOARD_SPLITTO_LEFT || BOARD_SPLITTO_RIGHT

config BOARD
    default "splitto"

config ZMK_SPLIT
    default y

config BT_CTLR
    default BT

if USB

config USB_NRFX
    default y

config USB_DEVICE_STACK
    default y

endif # USB

# External 32 kHz crystal oscillator
choice CLOCK_CONTROL_NRF_K32SRC
    default CLOCK_CONTROL_NRF_K32SRC_XTAL
endchoice

choice CLOCK_CONTROL_NRF_K32SRC_ACCURACY
    default CLOCK_CONTROL_NRF_K32SRC_150PPM
endchoice

endif # LEFT or RIGHT
```

## boards/jsw/controllo/Kconfig.controllo
```kconfig
config BOARD_CONTROLLO
    select SOC_NRF52840_QIAA
    select ZMK_BOARD_COMPAT if BOARD_CONTROLLO_NRF52840_ZMK
    imply RETAINED_MEM if BOARD_CONTROLLO_NRF52840_ZMK
    imply RETENTION if BOARD_CONTROLLO_NRF52840_ZMK
    imply RETENTION_BOOT_MODE if BOARD_CONTROLLO_NRF52840_ZMK
    
config BOARD_ENABLE_DCDC
    bool "Enable DCDC mode"
    select SOC_DCDC_NRF52X
    default y
    depends on BOARD_CONTROLLO
```

## boards/jsw/controllo/board.yml
```yaml
board:
  name: controllo
  vendor: jsw
  socs:
    - name: nrf52840
      variants:
        - name: zmk
```
